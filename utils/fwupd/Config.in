## utils/fwupd/Config.in
```kconfig
menu "Select fwupd options"
	depends on PACKAGE_fwupd-libs

config FWUPD_FIRMWARE_PACKAGER
	bool "firmware packager"
	default n
	help
	  Compile fwupd with firmware packager

config FWUPD_HSI
	bool "Host Security ID"
	default n
	help
	  Compile fwupd with HSI support

config FWUPD_LVFS
	bool "LVFS remote"
	default y
	help
	  Compile and install LVFS remote

config FWUPD_CBOR
	bool "CBOR"
	default n
	help
	  Compile fwupd with cbor protocol support

config FWUPD_LIBARCHIVE
	bool "libarchive"
	default y
	help
	  Compile fwupd with libarchive support

config FWUPD_LIBDRM
	bool "libdrm"
	default n
	help
	  Compile fwupd with libdrm support

config FWUPD_READLINE
	bool "readline"
	default y
	help
	  Compile fwupd with libreadline support

config FWUPD_PROTOBUF
	bool "protbuf"
	default n
	help
	  Compile fwupd with protobuf support

config FWUPD_PLUGIN_MODEMMANAGER
	bool "ModemManager plugin"
	default y
	help
	  Compile fwupd with ModemManager plugin

endmenu
```
